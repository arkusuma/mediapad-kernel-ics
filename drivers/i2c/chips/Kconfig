## drivers/i2c/chips/Kconfig
```kconfig
#
# Miscellaneous I2C chip drivers configuration
#
# *** DEPRECATED! Do not add new entries! See Makefile ***
#

menu "Miscellaneous I2C Chip support"


#/* <BU5D07680 liujinggang 20100413 begin */
config S7_FEATURE_SENSORS_ST_LSM303DLH
	tristate "LSM303DLH is a 6D sensors(gs&ms)"
	default n
	help
	 The LSM303DLH is a system-in-package featuring a 3D
	 digital linear acceleration sensor and a 3D digital magnetic sensor.
#/* BU5D07680 liujinggang 20100413 end> */
endmenu
```

## drivers/input/belasigna/Kconfig
```kconfig
config BELASIGNA_BS300
#
	tristate "BELASIGNA BS300 AUDIO"	
#
	depends on I2C_QUP
	help
	  Say Y here if you have the BELASIGNA BS300. 
```

## drivers/input/sim/Kconfig
```kconfig
config SIM_DETECT
	bool "Sim card detect"	
	default y
	help
	  Say Y here if you want to detect sim card.
```
